//#include <dt-bindings/zmk/matrix_transform.h>

/ {
    chosen {
        zmk,kscan = &kscan0;
//        zmk,matrix_transform = &default_transform;
    };

    kscan0: kscan_0 {
        compatible = "zmk,kscan-gpio-matrix";
        label = "KSCAN";
        diode-direction = "col2row";

        col-gpios
            = <&nice_nano_v2 006 GPIO_ACTIVE_HIGH>
            , <&nice_nano_v2 008 GPIO_ACTIVE_HIGH>
            , <&nice_nano_v2 017 GPIO_ACTIVE_HIGH>
            , <&nice_nano_v2 020 GPIO_ACTIVE_HIGH>
            , <&nice_nano_v2 022 GPIO_ACTIVE_HIGH>
            , <&nice_nano_v2 024 GPIO_ACTIVE_HIGH>
            , <&nice_nano_v2 100 GPIO_ACTIVE_HIGH>
            , <&nice_nano_v2 011 GPIO_ACTIVE_HIGH>
            , <&nice_nano_v2 104 GPIO_ACTIVE_HIGH>
            , <&nice_nano_v2 106 GPIO_ACTIVE_HIGH>
            ;

        row-gpios
            = <&nice_nano_v2 031 (GPIO_ACTIVE_HIGH | GPIO_PULL_DOWN)>
            , <&nice_nano_v2 029 (GPIO_ACTIVE_HIGH | GPIO_PULL_DOWN)>
            , <&nice_nano_v2 002 (GPIO_ACTIVE_HIGH | GPIO_PULL_DOWN)>
            , <&nice_nano_v2 115 (GPIO_ACTIVE_HIGH | GPIO_PULL_DOWN)>
            , <&nice_nano_v2 113 (GPIO_ACTIVE_HIGH | GPIO_PULL_DOWN)>
            , <&nice_nano_v2 111 (GPIO_ACTIVE_HIGH | GPIO_PULL_DOWN)>
            , <&nice_nano_v2 010 (GPIO_ACTIVE_HIGH | GPIO_PULL_DOWN)>
            , <&nice_nano_v2 009 (GPIO_ACTIVE_HIGH | GPIO_PULL_DOWN)>
            , <&nice_nano_v2 107 (GPIO_ACTIVE_HIGH | GPIO_PULL_DOWN)>
            ;
    };

//    default_transform: keymap_transform_0 {
//        compatible = "zmk,master-transform";
//        cols = <10>;
//        rows = <9>;
//        map = <
//        >;
//    };

};
