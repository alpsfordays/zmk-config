## config/boards/shields/Ricoh/Kconfig.defconfig
```kconfig
if SHIELD_RICOH

config ZMK_KEYBOARD_NAME
    default "Ricoh"

CONFIG_BT
    default y

CONFIG_ZMK_BLE
    default y

endif
```

## config/boards/shields/planckML/Kconfig.defconfig
```kconfig
if SHIELD_PLANCKML

config ZMK_KEYBOARD_NAME
    default "planckML"

config BT
    default y

config ZMK_BLE
    default y

endif
```

## config/boards/shields/ricoh/Kconfig.defconfig
```kconfig
if SHIELD_RICOH

config ZMK_KEYBOARD_NAME
    default "Ricoh"

config BT
    default y

config ZMK_BLE
    default y

endif
```
